## conf/layer.conf
```bitbake
DISTRO_FEATURES:remove = "x11"

LICENSE_FLAGS_ACCEPTED += "synaptics-killswitch"

IMAGE_ROOTFS_SIZE = "400000"
BOOT_SPACE = "70000"

MACHINE_FEATURES:append = " framebuffer"

RPI_USE_U_BOOT = "1"

DISABLE_VC4GRAPHICS = "1"

DISABLE_RPI_BOOT_LOGO = "1"

DISTRO_FEATURES:append = " systemd usrmerge"

DISTRO_FEATURES:remove = "sysvinit"
VIRTUAL-RUNTIME_init_manager = "systemd"
VIRTUAL-RUNTIME_initscripts = "systemd-compat-units"

KERNEL_CMDLINE += "init=/lib/systemd/systemd"

IMAGE_INSTALL:append = " systemd lvgl-demo bootlogo"

#disable-getty
EXTRA_USERS_PARAMS = "usermod -a -G input root"

USB_POWER_ENABLE = "1"

IMAGE_FEATURES:append = " splash"

# We have a conf and classes directory, add to BBPATH
BBPATH .= ":${LAYERDIR}"

BBFILES += "${LAYERDIR}/conf/*.bbappend"

# We have recipes-* directories, add to BBFILES
BBFILES += "${LAYERDIR}/recipes-*/*/*.bb \
            ${LAYERDIR}/recipes-*/*/*.bbappend"

BBFILES += "${LAYERDIR}/recipes-*/*/*/*.bb \
            ${LAYERDIR}/recipes-*/*/*/*.bbappend"
```
